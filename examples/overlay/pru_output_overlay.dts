/dts-v1/;
/plugin/;

/ {
    compatible = "ti,beaglebone", "ti,beaglebone-black";

	/* identification */
	part-number = "PRU-PARALLEL";

	/* version */
	version = "00A0";

	fragment@0 {
		target = <&am33xx_pinmux>;
		__overlay__ {
			pruicss_pins: pinmux_pruicss_pins {
            		pinctrl-single,pins = <
            			0x190 0x05	/* P9_31 to PRU output */
            			0x194 0x05	/* P9_29 to PRU output */
            			0x198 0x05	/* P9_30 to PRU output */
            			0x19C 0x05	/* P9_28 to PRU output */
            			0x1A4 0x05	/* P9_27 to PRU output */
            			0x1AC 0x05	/* P9_25 to PRU output */
            			>;
            };
		};
	};

	fragment@2 {
		target = <&pruss>;
		__overlay__{
			status = "okay";
			pinctrl-names = "default";
			pinctrl-0 = <&pruicss_pins>;
		};
	};
};
